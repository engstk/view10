## drivers/connectivity/hi11xx/hi1103/platform/Kconfig
```kconfig
menuconfig HI1102_PLATFORM
	tristate "Hisilicon Wireless Connectivity Hi11xx Platform Module"
	depends on CONNECTIVITY_HI110X
	default m
	---help---
		If you want to use Hisilicon  Wireless Connectivity,first choose this.

if HI1102_PLATFORM

config HI1102_PLAT_HW_CHR
  bool "Hisilicon 1102 platform chr log"
  default y
  ---help---
	Hisilicon 1102 platform chr log

config HI1102_PLAT_OAL
  bool "Hisilicon 1102 platform oal module"
  default y
  select HI110X_SDIO_STD_CARD_SUPPORT
  select HI110X_SDIO_DETECT_FUNCTION
  ---help---
	Hisilicon 1102 platform oal module

config HI1102_PLAT_FRW
  bool "Hisilicon 1102 platform framework module"
  default y
  ---help---
	Hisilicon 1102 platform oal module

config HI1102_PLAT_OAM
  bool "Hisilicon 1102 platform oam module"
  default y
  ---help---
	Hisilicon 1102 platform oam module

config HI1102_PLAT_SDT
  bool "Hisilicon 1102 platform sdt module"
  default y
  ---help---
	Hisilicon 1102 platform sdt module

config HI1102_PLAT_PS
  bool "Hisilicon 1102 platform ps module"
  default y
  ---help---
	Hisilicon 1102 platform ps module

config HI1102_PLAT_PM
  bool "Hisilicon 1102 platform power manager module"
  default y
  ---help---
	Hisilicon 1102 platform power manager module

config HI1102_PLAT_MAIN
  bool "Hisilicon 1102 platform main module"
  default y
  ---help---
	Hisilicon 1102 platform main module

config HI110X_GPS_REFCLK
  bool "Hisilicon 110X gps refclk feature"
  default y
  ---help---
    Hisilicon 110X gps refclk feature

config HI110X_GPS_REFCLK_INTERFACE
  bool "Hisilicon 110X gps refclk interface with hwgps"
  default n
  ---help---
    Hisilicon 110X gps refclk interface with hwgps

choice
  prompt "GPS RefClk Type"
  default HI110X_GPS_REFCLK_SRC_3
  config HI110X_GPS_REFCLK_SRC_1
    bool "modem provide gps one ref clk source, like plat A"
  config HI110X_GPS_REFCLK_SRC_2
    bool "modem provide gps two ref clk source, like plat D"
  config HI110X_GPS_REFCLK_SRC_3
    bool "modem provide gps three ref clk source, other plat"
endchoice

config HI110X_GPS_SYNC
  bool "Hisilicon 110X gps sync feature"
  default n
  ---help---
    Hisilicon 110X gps sync feature temp default n till sync feature of other module complete

endif
```

## drivers/hisi/l3cache/Kconfig
```kconfig
menu "Hisi L3 Cache Share"
config HISI_L3CACHE_SHARE
	bool "l3 share"
	default n
	help
	 support l3 cache share

config HISI_L3CACHE_DEBUG
	bool "l3cache debug"
	depends on HISI_L3CACHE_SHARE
	default n
	help
	 support l3cache debug

endmenu
```

## drivers/huawei_platform/net/netbooster/Kconfig
```kconfig
config HW_NETBOOSTER_MODULE
	tristate "netbooster:video acceleration and net ai change"
    default n
    help
	  This module adds netbooster kernel suport for kirin chipset.
```

## drivers/huawei_platform/power/battery/Kconfig
```kconfig
menu "Battery certification support"

menuconfig HUAWEI_BATTERY_INFORMATION
	bool
    prompt "Certificate battery by information of IC."
	default n

config CERTIFICATION_IC_DS28EL15
	bool
    prompt "Support ds28el15 as certification IC."
    depends on HUAWEI_BATTERY_INFORMATION
	default n
    help
        It needs a onewire physical controller to work.

config DS28EL15_COMMUNICATION_DEBUG
	bool
    prompt "Support ds28el15 communication debug."
    depends on HUAWEI_BATTERY_INFORMATION
    depends on CERTIFICATION_IC_DS28EL15
	default n
    help
        It defines some nodes for trigger communication between ds28el15 and SoC.

config ONEWIRE_PHY_PL061_GPIO
	bool
    prompt "Onewire physical controller: pl061(GPIO)."
    depends on HUAWEI_BATTERY_INFORMATION
    depends on GPIO_PL061
	default n
    help
        It's a onewire physical controller!

endmenu
```

## drivers/media/huawei/camera/Kconfig
```kconfig
comment "Huawei Camera"

# source "drivers/media/huawei/camera/isp/Kconfig"
source "drivers/media/huawei/camera/hisp/Kconfig"
source "drivers/media/huawei/camera/sensor/Kconfig"
source "drivers/media/huawei/camera/laser/Kconfig"
source "drivers/media/huawei/camera/fd/Kconfig"

source "drivers/media/huawei/camera/platform/Kconfig"

menuconfig HISI_CAMERA_LASER
    bool "Huawei laser support"
    default n
    help
        Say Y here to enable Laser for Huawei camera

menuconfig HISI_CAMERA_FLASH
    bool "Huawei flash support"
    default n
    help
        Say Y here to enable Flash for Huawei camera

config HISI_CAMERA_HISTAR_ISPV110
    tristate "Support histar ispv110 driver"
    depends on HUAWEI_CAMERA
    default n
    ---help---
        Hisilicon histar ispv110 driver.

config HISI_CAMERA_HISTAR_ISPV150
    tristate "Support histar ispv150 driver"
    depends on HUAWEI_CAMERA
    default n
    ---help---
        Hisilicon histar ispv150 driver.

config HISI_CAMERA_HISTAR_ISPV160
    tristate "Support histar ispv160 driver"
    depends on HUAWEI_CAMERA
    default n
    ---help---
        Hisilicon histar ispv160 driver.

config HISI_CAMERA_HISTAR_ISPV120
    tristate "Support histar ispv120 driver"
    depends on HUAWEI_CAMERA
    default n
    ---help---
        Hisilicon histar ispv120 driver.

config HISI_CAMERA_HISTAR_ISPV200
    tristate "Support histar ispv200 driver"
    depends on HUAWEI_CAMERA
    default n
    ---help---
        Hisilicon histar ispv200 driver.

config HISI_CAMERA_ISP_SECURE
    tristate "Support histar isp secure"
    depends on HUAWEI_CAMERA
    default n
    ---help---
        Hisilicon histar isp secure.
```
